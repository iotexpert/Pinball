# CYBLE_014008_00 register map
File version: 0.1
PSoC 4200 BLE
Registers are 32-bit, read-write, no defined reset value unless marked. A register's access mark holds for its fields unless they carry their own. Offsets are from the block's base; lines under a group give offsets from that group; [hi:lo] are bit positions; {n}, {i} and the like mark numbered series; 'fields as' and 'values as' point back to an identical list; <NAME> marks a mode.

## Memory map
0x00000000 PWM_R
0x00000000 CapSense_IDAC1 — IDAC
0x00000000 CapSense_IDAC2 — IDAC
0x00000000 I2C — Serial Communication Block
0x00000000 PWM_1
0x00000000 PWM_0
0x00000000 PWM_L
0x400F0072 CR_L
0x400F0073 CR_R

## CR_R
Base 0x400F0073
0x00 CR_R_CONTROL_REG 8-bit

## CR_L
Base 0x400F0072
Registers as CR_R (with CR_R read as CR_L).

## PWM_R
Base 0x00000000
0x40200188 COUNTER — Current counter value
0x4020018C CC — Compare / capture value
0x40200190 CC_BUF — Compare / capture buffer value
0x40200194 PERIOD — Period value
0x40200198 PERIOD_BUF — Period buffer value

## CapSense_IDAC1 — IDAC
Base 0x00000000
Same registers: CapSense_IDAC2 0x00000000
0x40280004 CSD_IDAC_POLARITY
0x40280008 CSD_IDAC
0x4028FF00 CSD_TRIM1 — CSD IDAC TRIM1
0x4028FF04 CSD_TRIM2 — CSD IDAC TRIM2

## PWM_1
Base 0x00000000
0x402001C8 COUNTER — Current counter value
0x402001CC CC — Compare / capture value
0x402001D0 CC_BUF — Compare / capture buffer value
0x402001D4 PERIOD — Period value
0x402001D8 PERIOD_BUF — Period buffer value

## PWM_0
Base 0x00000000
0x40200108 COUNTER — Current counter value
0x4020010C CC — Compare / capture value
0x40200110 CC_BUF — Compare / capture buffer value
0x40200114 PERIOD — Period value
0x40200118 PERIOD_BUF — Period buffer value

## PWM_L
Base 0x00000000
0x40200148 COUNTER — Current counter value
0x4020014C CC — Compare / capture value
0x40200150 CC_BUF — Compare / capture buffer value
0x40200154 PERIOD — Period value
0x40200158 PERIOD_BUF — Period buffer value
